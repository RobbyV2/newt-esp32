## examples/basic/sdkconfig.defaults
```kconfig
CONFIG_FREERTOS_HZ=1000
CONFIG_LWIP_SO_REUSE=y
CONFIG_ESP_TASK_WDT_TIMEOUT_S=10
CONFIG_WS_TRANSPORT=y
CONFIG_LWIP_TCPIP_TASK_STACK_SIZE=4096
CONFIG_MBEDTLS_CERTIFICATE_BUNDLE=y
CONFIG_MBEDTLS_CERTIFICATE_BUNDLE_DEFAULT_FULL=y
CONFIG_HTTPD_MAX_REQ_HDR_LEN=1024
CONFIG_LWIP_PPP_SUPPORT=y
```
